## CMakeLists.txt
```
# SPDX-License-Identifier: Apache-2.0

cmake_minimum_required(VERSION 3.20.0)
find_package(Zephyr REQUIRED HINTS $ENV{ZEPHYR_BASE})
project(central)


target_sources(app PRIVATE
  src/marmonet_helpers.c
  src/main.c
)
```

## prj.conf
```kconfig
CONFIG_BT=y
CONFIG_BT_BROADCASTER=y
CONFIG_BT_OBSERVER=y
CONFIG_LOG=y

CONFIG_BT_ATT_PREPARE_COUNT=1
CONFIG_BT_BAS=y
CONFIG_BT_HRS=y
CONFIG_BT_IAS=y
CONFIG_BT_CTS=y
CONFIG_BT_CTS_HELPER_API=y
CONFIG_BT_PERIPHERAL=y
CONFIG_BT_DIS=y
CONFIG_BT_CENTRAL=y
CONFIG_BT_GATT_CLIENT=y

CONFIG_BT_CTLR_TX_PWR_PLUS_8=y  # Max +8 dBm for nRF52832/nRF52840

CONFIG_SENSOR=y
CONFIG_BT_RX_STACK_SIZE=4096 

CONFIG_THREAD_NAME=y
# CONFIG_THREAD_ANALYZER=y
# CONFIG_THREAD_ANALYZER_AUTO=y
# CONFIG_THREAD_ANALYZER_RUN_UNLOCKED=y
# CONFIG_THREAD_ANALYZER_USE_PRINTK=y
# CONFIG_THREAD_ANALYZER_AUTO_INTERVAL=5
CONFIG_CONSOLE=y
CONFIG_UART_CONSOLE=y
CONFIG_SERIAL=y
CONFIG_PRINTK=y
# CONFIG_BT_ATT_TX_COUNT=10

#CONFIG_COUNTER=y
#CONFIG_NRFX_RTC1=y  # or RTC0 or RTC2 — depending on which you want to use
```

## src/main.c
```c
#include <stdlib.h>

#include <zephyr/kernel.h>
#include <zephyr/rtio/rtio.h>
#include <zephyr/logging/log.h>
#include <zephyr/sys/util.h>

#include <zephyr/bluetooth/bluetooth.h>
#include <zephyr/bluetooth/hci.h>
#include <zephyr/bluetooth/conn.h>
#include <zephyr/bluetooth/uuid.h>
#include <zephyr/bluetooth/gatt.h>

#include "marmonet_structs.h"
#include "marmonet_params.h"
#include "marmonet_helpers.h"


#include <zephyr/drivers/gpio.h>
#include <zephyr/drivers/counter.h>


#define LED0_NODE DT_ALIAS(led0)
// #define COUNTER_NODE DT_NODELABEL(rtc2)

#define BT_RX_PRIO_STACK_SIZE 1024


/**
 * TODO
 * Test Env notify
 * Elaborate better the data recover struct using byte array
 * Refactor - break it down in multiple files, incraese readability
 * See the ideia of using indicator vs notify
 * Read notify from the node to recover data fast
 * Increase MTU
 * Put all data recovery in the same UUID (node and environment)
 * Solve the error of **No SOURCES given to Zephyr library: drivers__counter** when compiling
 *      Solution is my old computer, config in dts of pulga the rtc
 *      Uncommect the counter_dev and all realted things
 */

/**
 * @file This file hold the BS node of the Marmonet project.
 *     
*/

/**
 * @section DEFINES and globals
 */
//TODO Pass to the params file if it is possible
#define THREAD_STACK_SIZE 1024
K_THREAD_STACK_DEFINE(ble_thread_stack, THREAD_STACK_SIZE);
static struct k_thread ble_thread;
k_tid_t ble_thread_id;

K_THREAD_STACK_DEFINE(wakeup_thread_stack, THREAD_STACK_SIZE);
static struct k_thread wakeup_thread;
k_tid_t wakeup_thread_id;

#define KEY 0xCA
#define MAX_DEVICES 8

static const struct gpio_dt_spec led_o = GPIO_DT_SPEC_GET(LED0_NODE, gpios);
// const struct device *counter_dev = DEVICE_DT_GET(COUNTER_NODE);
uint32_t start_ticks;
uint32_t freq;

LOG_MODULE_REGISTER(main, LOG_LEVEL_DBG);

struct k_timer wakeup_timer;

int err;

const uint8_t my_id = 1;

MarmoNet_BSData BS_data;

uint8_t encounters = 0;

uint8_t events_recovered = 0;

//TODO pass it as constant as in riot
static uint8_t std_adv_data[] = { BS_KEY, my_id};

K_SEM_DEFINE(my_sem, 0, 1); //SEMPAHOR TO DEBUG


static const struct bt_data ad[] = {
	BT_DATA(BT_DATA_MANUFACTURER_DATA, std_adv_data, sizeof(std_adv_data)),
};

//Connection
static struct bt_conn *default_conn;
static struct bt_gatt_discover_params discover_service_params;
static struct bt_gatt_discover_params discover_char_params;
static struct bt_gatt_read_params read_params;
static struct bt_gatt_write_params write_params;
static struct k_work work_discover;


//Notify
bool env_notify;


/**
 * @section BLE GATT
*/
/*
    READ LAT & SYNC
*/
// read latency
static ssize_t gatt_read_lat(struct bt_conn *conn, const struct bt_gatt_attr *attr,
			void *buf, uint16_t len, uint16_t offset)
{
	const uint8_t value = 0xAF;

	return bt_gatt_attr_read(conn, attr, buf, len, offset, &value,
				 sizeof(value));
}

//Write the sync time to the nextwake up
static ssize_t gatt_write_sync(struct bt_conn *conn, const struct bt_gatt_attr *attr,
            void *buf, uint16_t len, uint16_t offset)
{
    uint32_t value;
    memcpy(&value, buf, sizeof(value));

    k_timer_start(&wakeup_timer, K_MSEC(value),  K_MSEC(3*MSEC_PER_SEC));
    LOG_INF("TIMER %i", value);
    LOG_INF("TIMER WRITE");

    return len;
}

/*
    READ MASK & SET NEW MASK
*/

//READ MASK
static ssize_t gatt_read_mask(struct bt_conn *conn, const struct bt_gatt_attr *attr,
			void *buf, uint16_t len, uint16_t offset)
{
    printk("mask reading %i\n", BS_data.info.current_mask);
	return bt_gatt_attr_read(conn, attr, buf, len, offset, &(BS_data.info.current_mask),
                            sizeof(BS_data.info.current_mask));
}

//SET NEW MASK
ssize_t gatt_write_new_mask(struct bt_conn *conn, const struct bt_gatt_attr *attr,
			void *buf, uint16_t len, uint16_t offset)
{
	
}

/*
    READ AND RECOVER DATA
*/

static ssize_t gatt_read_data_node(struct bt_conn *conn, const struct bt_gatt_attr *attr,
			void *buf, uint16_t len, uint16_t offset)
{

}

static ssize_t gatt_read_data_env(struct bt_conn *conn, const struct bt_gatt_attr *attr,
			void *buf, uint16_t len, uint16_t offset)
{
    uint8_t* index = &BS_data.info.not_sent_env;
    if(*index > 0)
    {
        *index = *index - 1;
        return bt_gatt_attr_read(conn, attr, buf, len, offset,
                                &(BS_data.bs_enviroment[*index]), 
                                sizeof(MarmoNet_BS_Enviroment));
    }

    MarmoNet_BS_Enviroment env = {
        .enviroment = {
            .comp_temp = 0,
            .comp_press = 0,
            .comp_humidity = 0
        },
        .event_n = UINT32_MAX
    };   
    return bt_gatt_attr_read(conn, attr, buf, len, offset, 
                            &(BS_data.bs_enviroment[BS_data.info.not_sent_env]),
                            sizeof(MarmoNet_BS_Enviroment));
}

/*
    READ NODE INFO
*/
static ssize_t gatt_read_inf(struct bt_conn *conn, const struct bt_gatt_attr *attr,
            void *buf, uint16_t len, uint16_t offset)
{

    return bt_gatt_attr_read(conn, attr, buf, len, offset, &(BS_data.info),
                            sizeof(BS_data.info));
}


void Env_thread_upload(void *arg1, void *arg2, void *arg3);


static void Env_ccc_cfg_changed(const struct bt_gatt_attr *attr,
				 uint16_t value)
{
	// env_notify = value == BT_GATT_CCC_NOTIFY;
    
    if(value == BT_GATT_CCC_NOTIFY)
        k_thread_create(&wakeup_thread, wakeup_thread_stack,
                    K_THREAD_STACK_SIZEOF(wakeup_thread_stack),
                    Env_thread_upload, NULL, NULL, NULL,
                    K_PRIO_COOP(7), 0, K_NO_WAIT);

}


/*
    GATT APIs
*/
static const struct bt_uuid_128 call_svc = BT_UUID_INIT_128(CALLITHRIX_SVC_UUID);
static const struct bt_uuid_128 call_char_sync_lat_uuid = BT_UUID_INIT_128(CALLITHRIX_CHR_SYNC_LAT_UUID);
static const struct bt_uuid_128 call_char_data_node_uuid = BT_UUID_INIT_128(CALLITHRIX_CHR_DATA_NODE);
static const struct bt_uuid_128 call_char_data_env_uuid = BT_UUID_INIT_128(CALLITHRIX_CHR_DATA_ENV);

static const struct bt_uuid_128 call_char_mask_uuid = BT_UUID_INIT_128(CALLITRHIX_CHR_SENSOR_MASK);
static const struct bt_uuid_128 call_char_info_uuid = BT_UUID_INIT_128(CALLITHRIX_CHR_STATUS_UUID);


/* Vendor Primary Service Declaration */
BT_GATT_SERVICE_DEFINE(marmonet_svc,
	BT_GATT_PRIMARY_SERVICE(&call_svc),

        //Char to catch lat using Cristian's algorithm.
        //It send only a byte to avoid miss reading the latency beacuse of processing time
	    BT_GATT_CHARACTERISTIC(&call_char_sync_lat_uuid.uuid,
		    	                BT_GATT_CHRC_READ | BT_GATT_CHRC_WRITE,
			                    BT_GATT_PERM_READ | BT_GATT_PERM_WRITE,
			                    gatt_read_lat, gatt_write_sync, NULL),

	    //Char to send the data saved in the node
        BT_GATT_CHARACTERISTIC(&call_char_data_node_uuid.uuid,
		    	                BT_GATT_CHRC_READ,
			                    BT_GATT_PERM_READ,
			                    gatt_read_data_node, NULL, NULL),

        BT_GATT_CHARACTERISTIC(&call_char_data_env_uuid.uuid,
		    	                BT_GATT_CHRC_READ | BT_GATT_CHRC_NOTIFY,
			                    BT_GATT_PERM_READ,
			                    gatt_read_data_env, NULL, NULL),
	        BT_GATT_CCC(Env_ccc_cfg_changed,
		        BT_GATT_PERM_READ | BT_GATT_PERM_WRITE),
        
            //Used to set a mask in the node
        BT_GATT_CHARACTERISTIC(&call_char_mask_uuid.uuid,
		    	                BT_GATT_CHRC_READ | BT_GATT_CHRC_WRITE,
			                    BT_GATT_PERM_READ | BT_GATT_PERM_WRITE,
			                    gatt_read_mask, gatt_write_new_mask, NULL),
	    //Recover all the status of the node
        BT_GATT_CHARACTERISTIC(&call_char_info_uuid.uuid,
		    	                BT_GATT_CHRC_READ,
			                    BT_GATT_PERM_READ,
			                    gatt_read_inf, NULL, NULL),
);

void Env_thread_upload(void *arg1, void *arg2, void *arg3)
{

    //TODO optimize it by hardcoding the attrs
	struct bt_gatt_attr *notify_crch =
		bt_gatt_find_by_uuid(marmonet_svc.attrs, 0xffff, &call_char_data_env_uuid.uuid);

    for(;BS_data.info.not_sent_env > 0; BS_data.info.not_sent_env--)
    {
        bt_gatt_notify(default_conn, notify_crch, &(BS_data.bs_enviroment[BS_data.info.not_sent_env - 1]), sizeof(MarmoNet_BS_Enviroment));

    }


}


/**
 * @section Discover and Callbacks
*/


static void gatt_write_cb(struct bt_conn *conn, uint8_t err,
                          struct bt_gatt_write_params *params)
{
    if (err) {
        LOG_ERR("GATT write failed (err %d)\n", err);
    } else {
        LOG_INF("GATT write successful!\n");
    }
    // bt_gatt_read(conn, &read_params);
}

static uint8_t gatt_read_data_cb(struct bt_conn *conn, uint8_t err,
                                struct bt_gatt_read_params *params,
                                const void *data, uint16_t length)
{
    if (err) {
        LOG_ERR("GATT read data fail (err %d)", err);
        return BT_GATT_ITER_STOP;
    }
    if(data){
        // BS_data.data_recovered[BS_data.info.not_sent_wakeup].events[events_recovered] = *(MarmoNet_Event*)data;
        memcpy(&BS_data.data_recovered[BS_data.info.not_sent_recovered].events[events_recovered], data, sizeof(MarmoNet_Event));
        LOG_INF("recover : %i yet to be recovered %i", events_recovered,  BS_data.data_recovered[BS_data.info.not_sent_recovered].abi_info.not_sent_wakeup);
        events_recovered++;
        if(events_recovered < BS_data.data_recovered[BS_data.info.not_sent_recovered].abi_info.not_sent_wakeup)
            {int err = bt_gatt_read(default_conn, &read_params);}
        else
            k_sem_give(&my_sem);



    }
    return BT_GATT_ITER_STOP;

}


uint32_t Cristian_alg(uint32_t timer_1, uint32_t timer_0)
{
    return (timer_1 - timer_0)/2;
}



static uint8_t gatt_read_sync_lat_cb(struct bt_conn *conn, uint8_t err,
                                struct bt_gatt_read_params *params,
                                const void *data, uint16_t length)
{

    uint32_t now_ticks;
    // counter_get_value(counter_dev, &now_ticks);
    /*
        TODO The timer is done in level o milliseconds, but we have 30 micro seconds precision
        The problem is that we are not sure about the tick compensation used
        in k_timer and the RTT of our system.

        Future works should explore how is timed this different functions and
        make it a better implementation.
    */
    //Cristian Algorithm
    uint32_t latency_ticks = ((now_ticks - start_ticks)/2) & 0x00FFFFFF;
    uint32_t latency_ms = latency_ticks*TICK_RTC_NS/1000000;
    LOG_INF("LATENCIA %i", latency_ms);

    //TODO in the real system 2* is not needed 
    //the timers are too far away and no conncetion doesnt exist before a call, only after
    //The 2* is used to avoid calling things from the past :)

    uint32_t _sync;
    
    write_params.handle = params->single.handle;
    write_params.data = &_sync;      // Pointer to the data to send
    write_params.length = sizeof(_sync); // Data size
    write_params.func = gatt_write_cb; // Callback for write confirmation

    _sync =  k_timer_remaining_get(&wakeup_timer) - latency_ms + 3000;

    err = bt_gatt_write(conn, &write_params);
    LOG_DBG("Writing new mask: %i", _sync);


}



static uint8_t gatt_read_info_cb(struct bt_conn *conn, uint8_t err,
                                struct bt_gatt_read_params *params,
                                const void *data, uint16_t length)
{
    if (err) {
        LOG_ERR("GATT read info failed (err %d)", err);
        return BT_GATT_ITER_STOP;
    }
    if(data){

        memcpy(&BS_data.data_recovered[BS_data.info.not_sent_recovered].abi_info, data, sizeof(MarmoNet_NodeInfo));
        if(BS_data.data_recovered[BS_data.info.not_sent_recovered].abi_info.current_mask != BS_data.info.current_mask){

            write_params.handle = params->single.handle;
            write_params.data = &BS_data.info.current_mask;      // Pointer to the data to send
            write_params.length = sizeof(BS_data.info.current_mask); // Data size
            write_params.func = gatt_write_cb; // Callback for write confirmation
            LOG_DBG("Writing new mask");


            err = bt_gatt_write(conn, &write_params);
       }
       if(BS_data.data_recovered[BS_data.info.not_sent_recovered].abi_info.not_sent_wakeup > 0){


            BS_data.data_recovered[BS_data.info.not_sent_recovered].array_size = BS_data.data_recovered[BS_data.info.not_sent_recovered].abi_info.not_sent_wakeup;
            BS_data.data_recovered[BS_data.info.not_sent_recovered].events = malloc(BS_data.data_recovered[BS_data.info.not_sent_recovered].array_size * sizeof(MarmoNet_Event));
            
            read_params.func = gatt_read_data_cb;
            read_params.by_uuid.uuid = &call_char_data_node_uuid;
            read_params.by_uuid.start_handle = BT_ATT_FIRST_ATTRIBUTE_HANDLE;
            read_params.by_uuid.end_handle = BT_ATT_LAST_ATTRIBUTE_HANDLE;

            int err = bt_gatt_read(default_conn, &read_params);

       }
    }
    // k_sem_give(&my_sem);
    
    return BT_GATT_ITER_STOP;

}

static uint8_t gatt_read_maks_cb(struct bt_conn *conn, uint8_t err,
                                struct bt_gatt_read_params *params,
                                const void *data, uint16_t length) {
    if (err) {
        LOG_ERR("GATT read failed (err %d)", err);
        return BT_GATT_ITER_STOP;
    }
    if (data) {
        uint8_t status = *(uint8_t *)data; // Assuming data is an integer
        LOG_INF("Received status: %i", status);
    }
    if (data) {
        LOG_INF("Data length: %d", length);
        for (int i = 0; i < length; i++) {
            LOG_INF("Byte %d: 0x%02x", i, ((uint8_t *)data)[i]);
        }
    }
    uint8_t value = 4;

    write_params.handle = params->single.handle;
    write_params.data = &value;      // Pointer to the data to send
    write_params.length = sizeof(value); // Data size
    write_params.func = gatt_write_cb; // Callback for write confirmation


    err = bt_gatt_write(conn, &write_params);
    if (err) {
        LOG_ERR("Failed to write (err %d)\n", err);
    }

    return BT_GATT_ITER_STOP;
}



// static uint8_t gatt_service_discover_cb(struct bt_conn *conn, const struct bt_gatt_attr *attr,
//                                 struct bt_gatt_discover_params *params) {
//     LOG_DBG("gatt service discover");
//     if (!attr) {
//         LOG_DBG("Discovery completed");
//         return BT_GATT_ITER_STOP;
//     }

//     LOG_DBG("Discovery ongoing");


//     struct bt_gatt_service_val *service = (struct bt_gatt_service_val *)attr->user_data;


//     discover_char_params.uuid = NULL;
//     discover_char_params.func = gatt_char_discover_cb;
//     discover_char_params.start_handle = attr->handle + 1;
//     discover_char_params.end_handle = service->end_handle;
//     discover_char_params.type = BT_GATT_DISCOVER_CHARACTERISTIC;

//     bt_gatt_discover(default_conn, &discover_char_params);
//     return BT_GATT_ITER_STOP;
// }

static void work_discover_cb(void *arg1, void *arg2, void *arg3)
{

    BS_data.info.n_wakeup++;



    read_params.func = gatt_read_sync_lat_cb;
    read_params.by_uuid.uuid = &call_char_sync_lat_uuid;
    read_params.by_uuid.start_handle = BT_ATT_FIRST_ATTRIBUTE_HANDLE;
    read_params.by_uuid.end_handle = BT_ATT_LAST_ATTRIBUTE_HANDLE;
    //Restart the counter before the read to make it more precise
    // counter_get_value(counter_dev, &start_ticks);
    
    int err = bt_gatt_read(default_conn, &read_params);

    //TODO descomentar
    // read_params.func = gatt_read_info_cb;
    // read_params.by_uuid.uuid = &call_char_info_uuid;
    // read_params.by_uuid.start_handle = BT_ATT_FIRST_ATTRIBUTE_HANDLE;
    // read_params.by_uuid.end_handle = BT_ATT_LAST_ATTRIBUTE_HANDLE;
    // int err = bt_gatt_read(default_conn, &read_params);

    // k_sem_take(&my_sem, K_FOREVER);


    // bt_conn_disconnect(conn, BT_HCI_ERR_REMOTE_USER_TERM_CONN);



    // LOG_INF("INFO READ: \n id: %i mask: %i data to recover: %i", 
    //         BS_data.data_recovered[BS_data.info.not_sent_recovered].abi_info.my_id,
    //         BS_data.data_recovered[BS_data.info.not_sent_recovered].abi_info.current_mask,
    //         BS_data.data_recovered[BS_data.info.not_sent_recovered].abi_info.not_sent_wakeup);

    // for(int i = 0; i < events_recovered; i++){
    //         LOG_INF("%i: \r\n"
    //                 "neighbors: %i \r\n"
    //                 "sensors %i %i %i \r\n ", 
    //                 i, 
    //                 BS_data.data_recovered[BS_data.info.not_sent_recovered].events[i].neighbors_id,
    //                 BS_data.data_recovered[BS_data.info.not_sent_recovered].events[i].enviroment.comp_press,
    //                 BS_data.data_recovered[BS_data.info.not_sent_recovered].events[i].enviroment.comp_humidity,
    //                 BS_data.data_recovered[BS_data.info.not_sent_recovered].events[i].enviroment.comp_temp);
    // }    
    
}



/**
 * @section BLE ROUTINES
*/



static void scan_callback(const bt_addr_le_t *addr, int8_t rssi, uint8_t adv_type,
            struct net_buf_simple *buf)
{
    //Detect if the advertise has the key and save it in the encounters variable
    if(buf->data[2] == KEY){
        LOG_INF("Device found: KEY %d ID %d ", buf->data[2], buf->data[3]);
        
        err = bt_le_scan_stop();
        
        if(err) LOG_ERR("Bluetooth stop scan error %i", err);

        err = bt_conn_le_create(addr, BT_CONN_LE_CREATE_CONN,
            BT_LE_CONN_PARAM_DEFAULT, &default_conn);

        if(err) LOG_ERR("Connection error %i", err);

    }
    
}




static void connected(struct bt_conn *conn, uint8_t err)
{
	char addr[BT_ADDR_LE_STR_LEN];

	bt_addr_le_to_str(bt_conn_get_dst(conn), addr, sizeof(addr));

	if (err) {
		LOG_ERR("Failed to connect to %s %u %s", addr, err, bt_hci_err_to_str(err));

		bt_conn_unref(default_conn);
		default_conn = NULL;

		// start_scan();
		return;
	}
    default_conn = bt_conn_ref(conn);
	LOG_INF("Connected: %s", addr);


    // k_work_submit(&work_discover);
    k_thread_create(&ble_thread, ble_thread_stack,
                K_THREAD_STACK_SIZEOF(ble_thread_stack),
                work_discover_cb, NULL, NULL, NULL,
                K_PRIO_COOP(7), 0, K_NO_WAIT);
}

static void disconnected(struct bt_conn *conn, uint8_t reason)
{
	char addr[BT_ADDR_LE_STR_LEN];

	if (conn != default_conn) {
		return;
	}

	bt_addr_le_to_str(bt_conn_get_dst(conn), addr, sizeof(addr));

	LOG_INF("Disconnected: %s, reason 0x%02x %s", addr, reason, bt_hci_err_to_str(reason));

	bt_conn_unref(default_conn);
	default_conn = NULL;

    gpio_pin_toggle_dt(&led_o);


    BS_data.data_recovered[BS_data.info.not_sent_recovered].array_size = events_recovered;
    events_recovered = 0;
    BS_data.info.not_sent_recovered++;

    

}

BT_CONN_CB_DEFINE(conn_callbacks) = {
	.connected = connected,
	.disconnected = disconnected,
};


//Adv routine to do the TDMA of our network
void adv_routine()
{
    //Start the adv
    err = bt_le_adv_start(BT_LE_ADV_CONN_FAST_1, ad, ARRAY_SIZE(ad),
                            NULL, 0);

    if(err) LOG_ERR("Bluetooth adv error %i", err);

    //Wait the turn duration
    k_sleep(K_MSEC(BS_UPDATE_DURATION));

    //Stop the advertise, it will automatically start the scan
    err = bt_le_adv_stop();
    if(err) LOG_ERR("Bluetooth adv stop error %i", err);
}




/**
 * @section DATA HANDLING
*/
void update_data()
{
    //SEPARAR ISSO PARA OUTRA FUNCAO EM OUTROS LOCAIS
#if USE_BMX
    err = fetch_bme280();

    if(!err)
    {
        BS_data.bs_enviroment[BS_data.info.not_sent_env].enviroment.comp_press = BS_data.info.current_mask & MARMONET_MASK_PRESSURE ? get_pressure() : 0;
        BS_data.bs_enviroment[BS_data.info.not_sent_env].enviroment.comp_humidity = BS_data.info.current_mask & MARMONET_MASK_HUMIDITY ? get_humidity() : 0;
        BS_data.bs_enviroment[BS_data.info.not_sent_env].enviroment.comp_temp = BS_data.info.current_mask & MARMONET_MASK_TEMPERATURE ? get_temperature() : 0;
        BS_data.bs_enviroment[BS_data.info.not_sent_env].event_n = BS_data.info.n_wakeup;
    }
#endif
    BS_data.info.last_sync++;
    BS_data.info.not_sent_env++;

}


/**
 * @section THREADS
*/

//The wakeup thread function will define how the system will work after each wakeup
void wakeup_thread_function(void *arg1, void *arg2, void *arg3)
{

    err = bt_le_scan_start(BT_LE_SCAN_PASSIVE, scan_callback);
	
    if (err) LOG_ERR("Scanning failed to start (err %d)", err);
    
    k_sleep(K_MSEC(TURN_DURATION*(MAX_DEVICES + 4)));


    adv_routine();
    

    err = bt_le_scan_stop();
    
    if(err) LOG_ERR("Bluetooth stop scan error %i", err);

    gpio_pin_toggle_dt(&led_o);

    update_data();

}

//Wakeup callback is the interuption that will start the wakeup thread to start the activities of our system
void wakeup_callback(struct k_timer *timer)
{

    k_thread_create(&wakeup_thread, wakeup_thread_stack,
                    K_THREAD_STACK_SIZEOF(wakeup_thread_stack),
                    wakeup_thread_function, NULL, NULL, NULL,
                    K_PRIO_COOP(7), 0, K_NO_WAIT);
    
}

void blinky_test(void *arg1, void *arg2, void *arg3)
{
    LOG_INF("Blinky test");
    gpio_pin_toggle_dt(&led_o);

}

void blinky_cb(struct k_timer *timer)
{

    LOG_INF("Blinky Callback");
    k_thread_create(&wakeup_thread, wakeup_thread_stack,
                    K_THREAD_STACK_SIZEOF(wakeup_thread_stack),
                    blinky_test, NULL, NULL, NULL,
                    K_PRIO_COOP(7), 0, K_NO_WAIT);    
}






/**
 * @section MAIN
*/

//Configure the system to start working
int main() {

	if (!gpio_is_ready_dt(&led_o)) {
        LOG_ERR("LED PROBLEM");
		return 0;
	}
    // if (!device_is_ready(counter_dev)) {
    //     LOG_ERR("COUNTER PROBLEM");
    //     return;
    // }

    init_bme280();
    // counter_start(counter_dev);
    // uint32_t freq = counter_get_frequency(counter_dev); // usually 32768 Hz

	gpio_pin_configure_dt(&led_o, GPIO_OUTPUT_ACTIVE);


    BS_data.info.my_id = my_id;
    BS_data.info.current_mask = MARMONET_MASK_ID | MARMONET_MASK_PRESSURE | MARMONET_MASK_TEMPERATURE | MARMONET_MASK_HUMIDITY;
    BS_data.info.last_sync = 0;
    BS_data.info.n_wakeup = 0;
    BS_data.info.not_sent_recovered = 0;
    BS_data.info.not_sent_env = 0;


    err = bt_enable(NULL);
    if(err)
        LOG_ERR("Bluetooth Error %i", err);
    
    // k_timer_init(&wakeup_timer, wakeup_callback, NULL);

    //TODO inicio tem q ter um adiantamento, janela expandida
    // k_timer_start(&wakeup_timer, K_MSEC(1000),  K_MSEC(WAKEUP_PERIOD));

    // err = bt_le_adv_start(BT_LE_ADV_CONN_FAST_1, ad, ARRAY_SIZE(ad),
    //                     NULL, 0);

    // k_work_init(&work_discover, work_discover_cb);

    k_timer_init(&wakeup_timer, blinky_cb, NULL);
    k_timer_start(&wakeup_timer, K_MSEC(1000),  K_MSEC(3000));

    k_sleep(K_MSEC(2000));


    err = bt_le_scan_start(BT_LE_SCAN_PASSIVE, scan_callback);
}
```

## src/marmonet_params.h
```c
#ifndef _MARMONET_PARAMS_H
#define _MARMONET_PARAMS_H

/*
    CONFIGURATION PARAMETERS
*/

/*
    TIMER AND WAKEUP CYCLES
*/


#define WAKEUP_PERIOD       32*MSEC_PER_SEC //SECONDS
#define DUTY_CYCLE          50/100 //in PERCENT
// #define DRIFT_TOLERANCE     10/100 //PERCENT
#define TOLERANCE_TIME_ZONE 0  // TODO THIS SHOULD BE IN PERCENTAGE BUT IT IS HARDOCDED FOR NOWWAKEUP_PERIOD*DUTY_CYLCE*DRIFT_TOLERANCE
#define LOOPS               1 //number of times each node will adv (create a loop for round robin)
#define MAX_NODES           2 //Number of nodes in the sysmte
#define TURN_DURATION       (WAKEUP_PERIOD*DUTY_CYCLE - TOLERANCE_TIME_ZONE)/(LOOPS*MAX_NODES)

//For now we are using a single timer type so this is a sequence in a row
#define NMBR_WKPS_SEQ 10     

#define LONG_SLEEP 1*WAKEUP_PERIOD

#define BS_UPDATE_DURATION 5*60*MSEC_PER_SEC //5 minutes

/*
    FAIL SAFE CONFIG
*/
#define USE_FAIL_SAFE       0
#define WAKEUP_FAIL_SAFE    10*MSEC_PER_SEC
#define FAIL_SAFE_ADV_TIMER 5*MSEC_PER_SEC

/*
    SENSORS CONFIGURATIONS
*/

#define USE_BMX          1 //0 do not use BMX 1 use it
    #define USE_BAROMETER    1 //
    #define USE_TEMPERATURE  1 //
    #define USE_HUMIDITY     1 //

//NEED TO BE MORE DEV IF WE WILL USE IT
#define USE_BMI     (0) //Same as USE_BMX
    #define USE_ACC     (0)
    #define USE_GYRO    (0)


#define USE_SI1133  0 //TODO Integrate with Pulga

/*
    FAILSAFE PARAMETERS
*/

// The usage of wdt to recover the sysmte if it faisl
#define USE_WDT     0 //WATCHDOG USAGE
    #define WDT_TIMEOUT     10*WAKEUP_PERIOD

#define MAX_TIME_WTHT_SYNC  10





/*
    CONSTANTS
*/

#define TICK_RTC_NS 30517


/*
    BLE MARMONET
*/

#define KEY_SIZE        0x2 //ONE FOR THE FIELD ONE FOR THE NAME
#define KEY             0xCA
#define BS_KEY          0xEB
#define KEY_FAIL_SAFE   0xFF

/*
    BLE
*/

#define CALLITHRIX_SVC_UUID                 BT_UUID_128_ENCODE(0x02b454b7, 0xc19f, 0x4d1c, 0xa2c0, 0xb7fc10f8a8a5)

#define CALLITHRIX_CHR_SYNC_TIMER_UUID      BT_UUID_128_ENCODE(0x682d75cf, 0x44fc, 0x4df4, 0xac81, 0x00f02aa9b98c)
#define CALLITHRIX_CHR_SYNC_LAT_UUID        BT_UUID_128_ENCODE(0x9b8606b1, 0x4117, 0x4aea, 0x94dc, 0xa3956ac8cde5)

#define CALLITHRIX_CHR_DATA_NODE            BT_UUID_128_ENCODE(0xd6a11e21, 0xc6e1, 0x49ed, 0x8355, 0x839e6fe3151e)
#define CALLITHRIX_CHR_DATA_ENV             BT_UUID_128_ENCODE(0x06f27084, 0x15c4, 0x46f0, 0xabbf, 0x0ea21ad1699f)


#define CALLITRHIX_CHR_SENSOR_MASK            BT_UUID_128_ENCODE(0xC066FF11, 0x7688, 0x4143, 0x9A01, 0x796BA6E66557)
// #define CALLITRHIX_CHR_SENSOR_OFF           BT_UUID_128_ENCODE(0x120c194e, 0xc810, 0x4a5e, 0xa131, 0x5439b0139106)


#define CALLITHRIX_CHR_STATUS_UUID          BT_UUID_128_ENCODE(0x59DE87C8, 0x9D62, 0x4D18, 0x884E, 0xE551B8385F85)



// #define MAXPAYLOAD_SIZE     BLE_ATT_MTU_MAX //bytes


#endif
```

## src/marmonet_structs.h
```c
#ifndef _MARMONET_STRUCTS_H
#define _MARMONET_STRUCTS_H

#include "marmonet_params.h"

//ID for animal identification
typedef enum _MarmoNet__ID {
  MARMONET_ID_COLOMBINI = 0b00000001,
  MARMONET_ID_LOUISE    = 0b00000010,
  MARMONET_ID_ISA       = 0b00000100,
  MARMONET_ID_BRUNO     = 0b00001000,
  MARMONET_ID_PEDRO     = 0b00010000,
  MARMONET_ID_LUIZA     = 0b00100000,
  MARMONET_ID_MARCIO    = 0b01000000,
  MARMONET_ID_MAMACO    = 0b10000000,
} MarmoNet_ID;


//Masks to activate or deactivate a sensor
typedef enum {

  MARMONET_MASK_ID          = 0b00000001,
  MARMONET_MASK_PRESSURE    = 0b00000010,
  MARMONET_MASK_HUMIDITY    = 0b00000100,
  MARMONET_MASK_TEMPERATURE = 0b00001000,
  MARMONET_MASK_LUMENS      = 0b00010000,

}DATA_MASK;


struct bme280_reading {
	/* Compensated values. */
	int32_t comp_temp;
	uint32_t comp_press;
	uint32_t comp_humidity;
};

struct bme280_data {
	/* Compensation parameters. */
	uint16_t dig_t1;
	int16_t dig_t2;
	int16_t dig_t3;
	uint16_t dig_p1;
	int16_t dig_p2;
	int16_t dig_p3;
	int16_t dig_p4;
	int16_t dig_p5;
	int16_t dig_p6;
	int16_t dig_p7;
	int16_t dig_p8;
	int16_t dig_p9;
	uint8_t dig_h1;
	int16_t dig_h2;
	uint8_t dig_h3;
	int16_t dig_h4;
	int16_t dig_h5;
	int8_t dig_h6;

	/* Carryover between temperature and pressure/humidity compensation. */
	int32_t t_fine;

	uint8_t chip_id;

	struct bme280_reading reading;
};

// typedef struct 
// {
//     uint32_t pression;
//     int32_t temperature;
//     uint32_t humidity;

// } bme280_reading;

typedef struct _MarmoNet__Event__stack MarmoNet_Event_stack;

typedef struct _MarmoNet_Event{

  uint32_t event_n;
  uint8_t neighbors_id;
  uint8_t fail_safe_found;
#if USE_BMX
  struct bme280_reading enviroment;
#endif
  uint8_t mask;

}MarmoNet_Event;

#define MAX_EVENT_SEND  MAXPAYLOAD_SIZE/sizeof(MarmoNet_Event)


struct  _MarmoNet__Event__stack
{
 
  MarmoNet_Event event;

  MarmoNet_Event_stack* stack_wakeup;
};

typedef struct  _MarmoNet__NodeInfo
{
  uint8_t my_id;  //ID of the node
  uint16_t n_wakeup; //How many data were collected
  uint8_t not_sent_wakeup; //the nmber of data that were not recovered (work as index for the data array)
  uint8_t current_mask; //The current mask of data to be collected
  uint16_t last_sync; //Last time the node was synchronized

}MarmoNet_NodeInfo;

typedef struct  
{
  uint8_t my_id;  //ID of the node
  uint16_t n_wakeup; //How many data were collected
  uint8_t not_sent_recovered; //the nmber of data that were not recovered (work as index for the data array)
  uint8_t not_sent_env;
  uint8_t current_mask; //The current mask of data to be collected
  uint16_t last_sync; //Last time the node was synchronized

}MarmoNet_BSInfo;

typedef struct  _MarmoNet__CallithrixData
{
  MarmoNet_NodeInfo info;

  MarmoNet_Event wakeup_data[1000];
}MarmoNet_CallithrixData;


typedef struct
{
  MarmoNet_NodeInfo abi_info;
  uint16_t bs_event_n;

  uint8_t array_size;

  MarmoNet_Event* events;

}MarmoNet_data_recover;


typedef struct _MarmoNet__BS_Collection MarmoNet_BS_Collection;
typedef struct _MarmoNet__BS_Collection
{
  MarmoNet_data_recover data;

  MarmoNet_BS_Collection* stack_collection;

};

typedef struct 
{
  struct bme280_reading enviroment;

  uint32_t event_n;

}MarmoNet_BS_Enviroment;


typedef struct 
{
  MarmoNet_BSInfo info;

  MarmoNet_BS_Enviroment bs_enviroment[100];

  MarmoNet_data_recover data_recovered[100];

}MarmoNet_BSData;



#endif
```
