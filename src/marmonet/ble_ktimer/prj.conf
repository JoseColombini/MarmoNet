## CMakeLists.txt
```
# SPDX-License-Identifier: Apache-2.0

cmake_minimum_required(VERSION 3.20.0)
find_package(Zephyr REQUIRED HINTS $ENV{ZEPHYR_BASE})
project(ble_ktimer)


target_sources(app PRIVATE
  src/marmonet_helpers.c
  src/main.c
)
```

## prj.conf
```kconfig
CONFIG_BT=y
CONFIG_BT_BROADCASTER=y
CONFIG_BT_OBSERVER=y
CONFIG_LOG=y

CONFIG_BT_ATT_PREPARE_COUNT=1
CONFIG_BT_BAS=y
CONFIG_BT_HRS=y
CONFIG_BT_IAS=y
CONFIG_BT_CTS=y
CONFIG_BT_CTS_HELPER_API=y
CONFIG_BT_PERIPHERAL=y
CONFIG_BT_DIS=y

CONFIG_BT_CTLR_TX_PWR_PLUS_8=y  # Max +8 dBm for nRF52832/nRF52840

CONFIG_SENSOR=y

CONFIG_BT_RX_STACK_SIZE=4096
```

## src/main.c
```c
#include <stdlib.h>

#include <zephyr/kernel.h>
#include <zephyr/rtio/rtio.h>
#include <zephyr/logging/log.h>
#include <zephyr/sys/util.h>

#include <zephyr/bluetooth/bluetooth.h>
#include <zephyr/bluetooth/hci.h>
#include <zephyr/bluetooth/conn.h>
#include <zephyr/bluetooth/uuid.h>
#include <zephyr/bluetooth/gatt.h>


#include "marmonet_structs.h"
#include "marmonet_params.h"
#include "marmonet_helpers.h"


#include <zephyr/drivers/gpio.h>
#define LED0_NODE DT_ALIAS(led0)

/*
 * A build error on this line means your board is unsupported.
 * See the sample documentation for information on how to fix this.
 */
#define THREAD_STACK_SIZE 1024
K_THREAD_STACK_DEFINE(ble_thread_stack, THREAD_STACK_SIZE);
static struct k_thread ble_thread;
k_tid_t ble_thread_id;

//work
static struct k_work work_adv_start;



static const struct gpio_dt_spec led_o = GPIO_DT_SPEC_GET(LED0_NODE, gpios);


LOG_MODULE_REGISTER(main, LOG_LEVEL_DBG);

struct k_timer wakeup_timer;

int err;

const uint8_t my_id = MARMONET_ID_LOUISE;

MarmoNet_CallithrixData data;

uint8_t encounters = 0;

//TODO pass it as constant as in riot
static uint8_t std_adv_data[] = { KEY, my_id};

static const struct bt_data ad[] = {
	BT_DATA(BT_DATA_MANUFACTURER_DATA, std_adv_data, sizeof(std_adv_data)),
};


static struct bt_conn *default_conn;

uint8_t counter_to_debug = 0;
/**
 * @section BLE GATT
*/
/*
    READ LAT & SYNC
*/
// read latency
static ssize_t gatt_read_lat(struct bt_conn *conn, const struct bt_gatt_attr *attr,
			void *buf, uint16_t len, uint16_t offset)
{
	const uint8_t value = 0xAF;

	return bt_gatt_attr_read(conn, attr, buf, len, offset, &value,
				 sizeof(value));
}

//Write the sync time to the nextwake up
static ssize_t gatt_write_sync(struct bt_conn *conn, const struct bt_gatt_attr *attr,
            void *buf, uint16_t len, uint16_t offset)
{
    // uint32_t value;
    // memcpy(&value, buf, sizeof(value));

    k_timer_start(&wakeup_timer, K_MSEC(value),  K_MSEC(3*MSEC_PER_SEC));
    LOG_INF("TIMER %i", value);
    LOG_INF("TIMER WRITE");

    return len;
}

/*
    READ MASK & SET NEW MASK
*/

//READ MASK
static ssize_t gatt_read_mask(struct bt_conn *conn, const struct bt_gatt_attr *attr,
			void *buf, uint16_t len, uint16_t offset)
{
    printk("mask reading %i\n", data.info.current_mask);
	return bt_gatt_attr_read(conn, attr, buf, len, offset, &(data.info.current_mask),
                            sizeof(data.info.current_mask));
}

//SET NEW MASK
ssize_t gatt_write_new_mask(struct bt_conn *conn, const struct bt_gatt_attr *attr,
			void *buf, uint16_t len, uint16_t offset)
{
	
    memcpy(&(data.info.current_mask), buf, len);

	return len;
}

/*
    READ AND RECOVER DATA
*/

static ssize_t gatt_read_data(struct bt_conn *conn, const struct bt_gatt_attr *attr,
			void *buf, uint16_t len, uint16_t offset)
{
    //TODO check if the data is available   
    if(data.info.not_sent_wakeup == 0) return 0;

    ssize_t ret = bt_gatt_attr_read(conn, attr, buf, len, offset, 
                                    &(data.wakeup_data[data.info.not_sent_wakeup - 1]),
                                    sizeof(MarmoNet_Event));

    data.info.not_sent_wakeup--;

    return ret;
}

/*
    READ NODE INFO
*/
static ssize_t gatt_read_inf(struct bt_conn *conn, const struct bt_gatt_attr *attr,
            void *buf, uint16_t len, uint16_t offset)
{
        LOG_INF("INFO READ: \n id: %i mask: %i data to recover: %i", 
            data.info.my_id,
            data.info.current_mask,
            data.info.not_sent_wakeup);

    return bt_gatt_attr_read(conn, attr, buf, len, offset, &(data.info),
                            sizeof(data.info));
}


/*
    GATT APIs
*/
static const struct bt_uuid_128 call_svc = BT_UUID_INIT_128(CALLITHRIX_SVC_UUID);
static const struct bt_uuid_128 call_char_sync_lat_uuid = BT_UUID_INIT_128(CALLITHRIX_CHR_SYNC_LAT_UUID);
static const struct bt_uuid_128 call_char_data_uuid = BT_UUID_INIT_128(CALLITHRIX_CHR_DATA_TRANSFER);
static const struct bt_uuid_128 call_char_mask_uuid = BT_UUID_INIT_128(CALLITRHIX_CHR_SENSOR_MASK);
static const struct bt_uuid_128 call_char_info_uuid = BT_UUID_INIT_128(CALLITHRIX_CHR_STATUS_UUID);


/* Vendor Primary Service Declaration */
//TODO Please make it better, to much access to everything
//TODO Maybe using more chars and srvs to make it more granular I`m using big chunks to make it easier
BT_GATT_SERVICE_DEFINE(marmonet_svc,
	BT_GATT_PRIMARY_SERVICE(&call_svc),
        //Char to catch lat using Cristian's algorithm.
        //It send only a byte to avoid miss reading the latency beacuse of processing time
	    BT_GATT_CHARACTERISTIC(&call_char_sync_lat_uuid.uuid,
		    	                BT_GATT_CHRC_READ | BT_GATT_CHRC_WRITE,
			                    BT_GATT_PERM_READ | BT_GATT_PERM_WRITE,
			                    gatt_read_lat, gatt_write_sync, NULL),
	    //Char to send the data saved in the node
        BT_GATT_CHARACTERISTIC(&call_char_data_uuid.uuid,
	    	                    BT_GATT_CHRC_READ | BT_GATT_CHRC_WRITE,
			                    BT_GATT_PERM_READ | BT_GATT_PERM_WRITE,
			                    gatt_read_data, NULL, NULL),
	    //Used to set a mask in the node
        BT_GATT_CHARACTERISTIC(&call_char_mask_uuid.uuid,
		    	                BT_GATT_CHRC_READ | BT_GATT_CHRC_WRITE,
			                    BT_GATT_PERM_READ | BT_GATT_PERM_WRITE,
			                    gatt_read_mask, gatt_write_new_mask, NULL),
	    //Recover all the status of the node
        BT_GATT_CHARACTERISTIC(&call_char_info_uuid.uuid,
		    	                BT_GATT_CHRC_READ | BT_GATT_CHRC_WRITE,
			                    BT_GATT_PERM_READ | BT_GATT_PERM_WRITE,
			                    gatt_read_inf, gatt_write_new_mask, NULL),
);



/**
 * @section BLE ROUTINES
*/

static void connected(struct bt_conn *conn, uint8_t err)
{
	char addr[BT_ADDR_LE_STR_LEN];

	bt_addr_le_to_str(bt_conn_get_dst(conn), addr, sizeof(addr));

	if (err) {
		printk("Failed to connect to %s %u %s\n", addr, err, bt_hci_err_to_str(err));

		// bt_conn_unref(default_conn);
		default_conn = NULL;

		k_work_submit(&work_adv_start);

        return;
	}
    // default_conn = bt_conn_ref(conn);
	printk("Connected: %s\n", addr);




	// bt_conn_disconnect(conn, BT_HCI_ERR_REMOTE_USER_TERM_CONN);
}

static void disconnected(struct bt_conn *conn, uint8_t reason)
{
	char addr[BT_ADDR_LE_STR_LEN];

	// if (conn != default_conn) {
	// 	return;
	// }

	bt_addr_le_to_str(bt_conn_get_dst(conn), addr, sizeof(addr));

	printk("Disconnected: %s, reason 0x%02x %s\n", addr, reason, bt_hci_err_to_str(reason));

	// bt_conn_unref(default_conn);
	default_conn = NULL;

    // k_sleep(K_SECONDS(1));  // Give time for cleanup

    // k_work_submit(&work_adv_start);


}

BT_CONN_CB_DEFINE(conn_callbacks) = {
	.connected = connected,
	.disconnected = disconnected,
};



static void scan_callback(const bt_addr_le_t *addr, int8_t rssi, uint8_t adv_type,
            struct net_buf_simple *buf)
{
    //Detect if the advertise has the key and save it in the encounters variable
    if(buf->data[2] == KEY){
        LOG_INF("Device found: KEY %d ID %d \n", buf->data[2], buf->data[3]);
        encounters |= buf->data[3];
    }
    
}

//Adv routine to do the TDMA of our network
void adv_routine()
{
    //Start the adv
    err = bt_le_adv_start(BT_LE_ADV_CONN_FAST_1, ad, ARRAY_SIZE(ad),
                            NULL, 0);

    if(err) LOG_ERR("Bluetooth adv error %i", err);

    //Wait the turn duration
    k_sleep(K_MSEC(TURN_DURATION));

    //Stop the advertise, it will automatically start the scan
    err = bt_le_adv_stop();
    if(err) LOG_ERR("Bluetooth adv stop error %i", err);
}


/**
 * @section DATA HANDLING
*/

//update the data available and manage the stack memory, also handling with the masks
static void update_data()
{

    data.info.n_wakeup++;
    data.info.last_sync++;

    #if USE_FAIL_SAFE
        fail_safe = last_sync > MAX_TIME_WTHT_SYNC ? true : false; 
    #endif
    
    //TODO which is more optimal always running this code or the if?
    // if(encounters != my_id || encounters_fails != 0 || (current_mask & MARMONET_MASK_ID) != 0){

    if(data.info.current_mask == 0) return; //All sensors deativated
        //Increment the stack to be send

    data.wakeup_data[data.info.not_sent_wakeup].neighbors_id = data.info.current_mask & MARMONET_MASK_ID? encounters : 0;
    LOG_DBG("Neighbors %d", data.wakeup_data[data.info.not_sent_wakeup].neighbors_id);

    encounters = data.info.my_id;

#if USE_BMX
    err = fetch_bme280();

    if(!err)
    {
        data.wakeup_data[data.info.not_sent_wakeup].enviroment.comp_press = data.info.current_mask & MARMONET_MASK_PRESSURE ? get_pressure() : 0;
        data.wakeup_data[data.info.not_sent_wakeup].enviroment.comp_humidity = data.info.current_mask & MARMONET_MASK_HUMIDITY ? get_humidity() : 0;
        data.wakeup_data[data.info.not_sent_wakeup].enviroment.comp_temp = data.info.current_mask & MARMONET_MASK_TEMPERATURE ? get_temperature() : 0;
    }
#endif

    data.wakeup_data[data.info.not_sent_wakeup].event_n = data.info.n_wakeup;
    data.info.not_sent_wakeup++;
}

/**
 * @section THREADS
*/

//The wakeup thread function will define how the system will work after each wakeup
void wakeup_thread_function(void *arg1, void *arg2, void *arg3)
{

    err = bt_le_scan_start(BT_LE_SCAN_PASSIVE, scan_callback);
	
    if (err) LOG_ERR("Scanning failed to start (err %d)\n", err);
    
    k_sleep(K_MSEC(TURN_DURATION));

    gpio_pin_toggle_dt(&led_o);


    for(int round = 0; round < MAX_NODES; round++){
        if((1 << round) == my_id) adv_routine();
        else {k_sleep(K_MSEC(TURN_DURATION));}
    }
    
    err = bt_le_scan_stop();
    
    if(err) LOG_ERR("Bluetooth stop scan error %i", err);

    gpio_pin_toggle_dt(&led_o);

    update_data();
    if(counter_to_debug%3 == 0){
        for(int i = 0; i < 3; i++)
            LOG_ERR("%i: %i WAKEUP: \r\n"
                    "neighbors: %i \r\n"
                    "sensors %i %i %i \r\n ", 
                    counter_to_debug - i, data.wakeup_data[counter_to_debug - i].event_n,data.wakeup_data[counter_to_debug - i].neighbors_id,
                    data.wakeup_data[counter_to_debug - i].enviroment.comp_press,
                    data.wakeup_data[counter_to_debug - i].enviroment.comp_humidity,
                    data.wakeup_data[counter_to_debug - i].enviroment.comp_temp);
    }
    counter_to_debug++;
}

//Wakeup callback is the interuption that will start the wakeup thread to start the activities of our system
void wakeup_callback(struct k_timer *timer)
{

    k_thread_create(&ble_thread, ble_thread_stack,
                    K_THREAD_STACK_SIZEOF(ble_thread_stack),
                    wakeup_thread_function, NULL, NULL, NULL,
                    K_PRIO_COOP(7), 0, K_NO_WAIT);
    
}

void blinky_test(void *arg1, void *arg2, void *arg3)
{
    LOG_INF("Blinky test");
    gpio_pin_toggle_dt(&led_o);

}

void blinky_cb(struct k_timer *timer)
{

    LOG_INF("Blinky Callback");
    k_thread_create(&ble_thread, ble_thread_stack,
                    K_THREAD_STACK_SIZEOF(ble_thread_stack),
                    blinky_test, NULL, NULL, NULL,
                    K_PRIO_COOP(7), 0, K_NO_WAIT);    
}



static void adv_start(struct k_work *work)
{
    err = bt_le_adv_start(BT_LE_ADV_CONN_FAST_1, ad, ARRAY_SIZE(ad),
                        NULL, 0);
}

/**
 * @section MAIN
*/

//Configure the system to start working
int main() {

	if (!gpio_is_ready_dt(&led_o)) {
		return 0;
	}
    init_bme280();

	gpio_pin_configure_dt(&led_o, GPIO_OUTPUT_ACTIVE);
    

    data.info.my_id = my_id;
    data.info.current_mask = MARMONET_MASK_ID | MARMONET_MASK_PRESSURE | MARMONET_MASK_HUMIDITY | MARMONET_MASK_TEMPERATURE;
    data.info.last_sync = 0;
    data.info.n_wakeup = 0;
    data.info.not_sent_wakeup = 0;
    encounters = my_id;


    err = bt_enable(NULL);
    if(err)
        LOG_ERR("Bluetooth Error %i", err);


    //Adv for tests
    k_work_init(&work_adv_start, adv_start);
	k_work_submit(&work_adv_start);

    k_timer_init(&wakeup_timer, blinky_cb, NULL);


    // k_timer_init(&wakeup_timer, wakeup_callback, NULL);

    // k_timer_start(&wakeup_timer, K_MSEC(1000),  K_MSEC(WAKEUP_PERIOD));

}
```

## src/marmonet_helpers.c
```c
#include "marmonet_helpers.h"
#include <zephyr/device.h>
#include <zephyr/devicetree.h>
#include <zephyr/logging/log.h>
#include <zephyr/kernel.h>
#include <zephyr/sys/ring_buffer.h>

/**
 * IMPLEMENTATIONS
 */
LOG_MODULE_REGISTER(helpers, LOG_LEVEL_DBG);


const struct device *bme280;

// Gets and initializes device
int init_bme280()
{
    LOG_DBG("Initializing BME280");
    bme280 = DEVICE_DT_GET_ANY(bosch_bme280);

    // Removes sensor API from registered APIs if cannot start sensor
    if (!bme280)
    {
        LOG_ERR("bme280 not declared at device tree");
        return -1;
    }
    else if (!device_is_ready(bme280))
    {
        LOG_ERR("device \"%s\" is not ready", bme280->name);
        return -1;
    }
    return 0;
}

int32_t get_temperature()
{
    struct bme280_data* data = bme280->data;
    LOG_DBG("Temperature: %d", data->reading.comp_temp);
    return data->reading.comp_temp;
}

uint32_t get_pressure()
{
    struct bme280_data* data = bme280->data;
    LOG_DBG("Pressure: %d", data->reading.comp_press);
    return data->reading.comp_press;
}

uint32_t get_humidity()
{
    struct bme280_data* data = bme280->data;
    LOG_DBG("Humidity: %d", data->reading.comp_humidity);
    return data->reading.comp_humidity;
}

int fetch_bme280()
{
sample_fetch:
    int error = sensor_sample_fetch(bme280);
    if(!error)
        return 0;
    if (error == -EAGAIN)
    {
        LOG_WRN("fetch sample from \"%s\" failed: %d, trying again",
                bme280->name, error);
        k_sleep(K_MSEC(1));
        goto sample_fetch;
    }
    else
    {
        LOG_ERR("fetch sample from \"%s\" failed: %d",
                bme280->name, error);
    }
    return 0;
}

// static void read_sensor_values(bmx_data* data)
// {
//     LOG_DBG("Reading BME280");


// sample_fetch:
//     int error = sensor_sample_fetch(bme280);
//     if (!error)
//     {
//         sensor_channel_get(bme280, SENSOR_CHAN_AMBIENT_TEMP,
//                            *data.temperature);
//         sensor_channel_get(bme280, SENSOR_CHAN_PRESS,
//                            *data.pressure);
//         sensor_channel_get(bme280, SENSOR_CHAN_HUMIDITY,
//                            *data.humidity);

//         memcpy(&bme280_data, &bme280_model, sizeof(SensorModelBME280));

//         if (insert_in_buffer(&app_buffer, bme280_data, BME280_MODEL, error, BME280_MODEL_WORDS) != 0)
//         {
//             LOG_ERR("Failed to insert data in ring buffer.");
//         }
//     }
//     else if (error == -EAGAIN)
//     {
//         LOG_WRN("fetch sample from \"%s\" failed: %d, trying again",
//                 bme280->name, error);
//         goto sample_fetch;
//     }
//     else
//     {
//         LOG_ERR("fetch sample from \"%s\" failed: %d",
//                 bme280->name, error);
//     }
// }
```

## src/marmonet_helpers.h
```c
#ifndef MARMONET_HELPERS_H
#define MARMONET_HELPERS_H

#include <zephyr/drivers/sensor.h>
#include "marmonet_structs.h"

int init_bme280();

int fetch_bme280();
int32_t get_temperature();
uint32_t get_pressure();
uint32_t get_humidity();

// static void read_sensor_values(bmx_data* data);


#endif
```

## src/marmonet_params.h
```c
#ifndef _MARMONET_PARAMS_H
#define _MARMONET_PARAMS_H

/*
    CONFIGURATION PARAMETERS
*/

/*
    TIMER AND WAKEUP CYCLES
*/


#define WAKEUP_PERIOD       32*MSEC_PER_SEC //SECONDS
#define DUTY_CYCLE          50/100 //in PERCENT
// #define DRIFT_TOLERANCE     10/100 //PERCENT
#define TOLERANCE_TIME_ZONE 0  // TODO THIS SHOULD BE IN PERCENTAGE BUT IT IS HARDOCDED FOR NOWWAKEUP_PERIOD*DUTY_CYLCE*DRIFT_TOLERANCE
#define LOOPS               1 //number of times each node will adv (create a loop for round robin)
#define MAX_NODES           2 //Number of nodes in the sysmte
#define TURN_DURATION       (WAKEUP_PERIOD*DUTY_CYCLE - TOLERANCE_TIME_ZONE)/(LOOPS*MAX_NODES)

//For now we are using a single timer type so this is a sequence in a row
#define NMBR_WKPS_SEQ 10     

#define LONG_SLEEP 1*WAKEUP_PERIOD


/*
    FAIL SAFE CONFIG
*/
#define USE_FAIL_SAFE       0
#define WAKEUP_FAIL_SAFE    10*MSEC_PER_SEC
#define FAIL_SAFE_ADV_TIMER 5*MSEC_PER_SEC

/*
    SENSORS CONFIGURATIONS
*/

#define USE_BMX          1 //0 do not use BMX 1 use it
    #define USE_BAROMETER    1 //
    #define USE_TEMPERATURE  1 //
    #define USE_HUMIDITY     1 //

//NEED TO BE MORE DEV IF WE WILL USE IT
#define USE_BMI     (0) //Same as USE_BMX
    #define USE_ACC     (0)
    #define USE_GYRO    (0)


#define USE_SI1133  0 //TODO Integrate with Pulga

/*
    FAILSAFE PARAMETERS
*/

// The usage of wdt to recover the sysmte if it faisl
#define USE_WDT     0 //WATCHDOG USAGE
    #define WDT_TIMEOUT     10*WAKEUP_PERIOD

#define MAX_TIME_WTHT_SYNC  10





/*
    CONSTANTS
*/

#define TICK_RTC_NS 30517


/*
    BLE MARMONET
*/

#define KEY_SIZE        0x2 //ONE FOR THE FIELD ONE FOR THE NAME
#define KEY             0xCA
#define KEY_FAIL_SAFE   0xFF

/*
    BLE
*/

#define CALLITHRIX_SVC_UUID                 BT_UUID_128_ENCODE(0x02b454b7, 0xc19f, 0x4d1c, 0xa2c0, 0xb7fc10f8a8a5)

#define CALLITHRIX_CHR_SYNC_TIMER_UUID      BT_UUID_128_ENCODE(0x682d75cf, 0x44fc, 0x4df4, 0xac81, 0x00f02aa9b98c)
#define CALLITHRIX_CHR_SYNC_LAT_UUID        BT_UUID_128_ENCODE(0x9b8606b1, 0x4117, 0x4aea, 0x94dc, 0xa3956ac8cde5)

#define CALLITHRIX_CHR_DATA_TRANSFER        BT_UUID_128_ENCODE(0xd6a11e21, 0xc6e1, 0x49ed, 0x8355, 0x839e6fe3151e)

#define CALLITRHIX_CHR_SENSOR_MASK            BT_UUID_128_ENCODE(0xC066FF11, 0x7688, 0x4143, 0x9A01, 0x796BA6E66557)
// #define CALLITRHIX_CHR_SENSOR_OFF           BT_UUID_128_ENCODE(0x120c194e, 0xc810, 0x4a5e, 0xa131, 0x5439b0139106)


#define CALLITHRIX_CHR_STATUS_UUID          BT_UUID_128_ENCODE(0x59DE87C8, 0x9D62, 0x4D18, 0x884E, 0xE551B8385F85)

// #define MAXPAYLOAD_SIZE     BLE_ATT_MTU_MAX //bytes


#endif
```

## src/marmonet_structs.h
```c
#ifndef _MARMONET_STRUCTS_H
#define _MARMONET_STRUCTS_H

#include "marmonet_params.h"

//ID for animal identification
typedef enum _MarmoNet__ID {
  MARMONET_ID_COLOMBINI = 0b00000001,
  MARMONET_ID_LOUISE    = 0b00000010,
  MARMONET_ID_ISA       = 0b00000100,
  MARMONET_ID_BRUNO     = 0b00001000,
  MARMONET_ID_PEDRO     = 0b00010000,
  MARMONET_ID_LUIZA     = 0b00100000,
  MARMONET_ID_MARCIO    = 0b01000000,
  MARMONET_ID_MAMACO    = 0b10000000,
} MarmoNet_ID;


//Masks to activate or deactivate a sensor
typedef enum {

  MARMONET_MASK_ID          = 0b00000001,
  MARMONET_MASK_PRESSURE    = 0b00000010,
  MARMONET_MASK_HUMIDITY    = 0b00000100,
  MARMONET_MASK_TEMPERATURE = 0b00001000,
  MARMONET_MASK_LUMENS      = 0b00010000,

}DATA_MASK;


struct bme280_reading {
	/* Compensated values. */
	int32_t comp_temp;
	uint32_t comp_press;
	uint32_t comp_humidity;
};

struct bme280_data {
	/* Compensation parameters. */
	uint16_t dig_t1;
	int16_t dig_t2;
	int16_t dig_t3;
	uint16_t dig_p1;
	int16_t dig_p2;
	int16_t dig_p3;
	int16_t dig_p4;
	int16_t dig_p5;
	int16_t dig_p6;
	int16_t dig_p7;
	int16_t dig_p8;
	int16_t dig_p9;
	uint8_t dig_h1;
	int16_t dig_h2;
	uint8_t dig_h3;
	int16_t dig_h4;
	int16_t dig_h5;
	int8_t dig_h6;

	/* Carryover between temperature and pressure/humidity compensation. */
	int32_t t_fine;

	uint8_t chip_id;

	struct bme280_reading reading;
};

// typedef struct 
// {
//     uint32_t pression;
//     int32_t temperature;
//     uint32_t humidity;

// } bme280_reading;

typedef struct _MarmoNet__Event__stack MarmoNet_Event_stack;

typedef struct _MarmoNet_Event{

  uint32_t event_n;
  uint8_t neighbors_id;
  uint8_t fail_safe_found;
#if USE_BMX
  struct bme280_reading enviroment;
#endif
  uint8_t mask;

}MarmoNet_Event;

#define MAX_EVENT_SEND  MAXPAYLOAD_SIZE/sizeof(MarmoNet_Event)


struct  _MarmoNet__Event__stack
{
 
  MarmoNet_Event event;

  MarmoNet_Event_stack* stack_wakeup;
};

typedef struct  _MarmoNet__NodeInfo
{
  uint8_t my_id;  //ID of the node
  uint16_t n_wakeup; //How many data were collected
  uint8_t not_sent_wakeup; //the nmber of data that were not recovered (work as index for the data array)
  uint8_t current_mask; //The current mask of data to be collected
  uint16_t last_sync; //Last time the node was synchronized

}MarmoNet_NodeInfo;

typedef struct  _MarmoNet__CallithrixData
{
  MarmoNet_NodeInfo info;

  MarmoNet_Event wakeup_data[100];
}MarmoNet_CallithrixData;


typedef struct
{
  MarmoNet_NodeInfo abi_info;
  uint16_t bs_event_n;
  struct bme280_reading bs_enviroment;

  uint8_t stack_size;

  MarmoNet_Event_stack* stack_head_wakeup;

}MarmoNet_data_recover;


typedef struct _MarmoNet__BS_Collection MarmoNet_BS_Collection;
typedef struct _MarmoNet__BS_Collection
{
  MarmoNet_data_recover data;

  MarmoNet_BS_Collection* stack_collection;

};

typedef struct 
{
  MarmoNet_NodeInfo info;

  MarmoNet_data_recover data_recovered[100];

}MarmoNet_BSData;



#endif
```

## src/sensors_interface.h
```c
#ifndef SENSORS_INTERFACE_H
#define SENSORS_INTERFACE_H

#include "marmonet_params.h"


/*
 * Refer to:
 * https://docs.zephyrproject.org/latest/kernel/services/threads/index.html
 */
// #define SENSORS_THREAD_STACK_SIZE 1024
// #define SENSORS_THREAD_PRIORITY 5 /* preemptible */

// Encoding used to map sensors APIs
// **Sensors must be on the same order as in DataType enum**
enum SensorType
{
	#if USE_BMX
		BME280,
	#endif
	#if USE_BMI
		BMI160,
	#endif
	#if USE_SI1133
		SI1133,
	#endif
	#if USE_SCD30
		SCD30,
	#endif
	MAX_SENSORS // Total number of sensors
};

// Functions exposed for each sensor
typedef struct
{
	// Initializes sensor
	int (*init_sensor)();
	// Reads sensor values and stores them in buffer
	void (*read_sensor_values)();
	// Data processing API
	// DataAPI *data_model_api;
} SensorAPI;

// List of registered sensor APIs
extern SensorAPI *sensor_apis[MAX_SENSORS];

// Registers callbacks for the used sensors
int register_sensors_callbacks();
// Initializes sensors and start reading them
int read_sensors();


// #TODO: probably will require sync
// Dynamically sets current sampling interval
// void set_sampling_interval(int new_interval);
// Gets current sampling interval
// int get_sampling_interval();

#endif /* SENSORS_INTERFACE_H */
```
